## Kconfig
```kconfig
# Copyright (c) 2023 GreenWaves Technologies SAS
# All rights reserved.
#
# Redistribution and use in source and binary forms, with or without
# modification, are permitted provided that the following conditions are met:
#
# 1. Redistributions of source code must retain the above copyright notice,
#    this list of conditions and the following disclaimer.
# 2. Redistributions in binary form must reproduce the above copyright
#    notice, this list of conditions and the following disclaimer in the
#    documentation and/or other materials provided with the distribution.
# 3. Neither the name of GreenWaves Technologies SAS nor the names of its
#    contributors may be used to endorse or promote products derived from
#    this software without specific prior written permission.
#
# THIS SOFTWARE IS PROVIDED BY THE COPYRIGHT HOLDERS AND CONTRIBUTORS "AS IS"
# AND ANY EXPRESS OR IMPLIED WARRANTIES, INCLUDING, BUT NOT LIMITED TO, THE
# IMPLIED WARRANTIES OF MERCHANTABILITY AND FITNESS FOR A PARTICULAR PURPOSE
# ARE DISCLAIMED. IN NO EVENT SHALL THE COPYRIGHT OWNER OR CONTRIBUTORS BE
# LIABLE FOR ANY DIRECT, INDIRECT, INCIDENTAL, SPECIAL, EXEMPLARY, OR
# CONSEQUENTIAL DAMAGES (INCLUDING, BUT NOT LIMITED TO, PROCUREMENT OF
# SUBSTITUTE GOODS OR SERVICES; LOSS OF USE, DATA, OR PROFITS; OR BUSINESS
# INTERRUPTION) HOWEVER CAUSED AND ON ANY THEORY OF LIABILITY, WHETHER IN
# CONTRACT, STRICT LIABILITY, OR TORT (INCLUDING NEGLIGENCE OR OTHERWISE)
# ARISING IN ANY WAY OUT OF THE USE OF THIS SOFTWARE, EVEN IF ADVISED OF THE
# POSSIBILITY OF SUCH DAMAGE.

menu "DENOISER APP menu"

    comment "Options"

    choice APP_MODE
        prompt "Application Mode"
        default DEMO

        config DEMO
            bool "Demo Mode"

        config DENOISE_WAV
            bool "DenoiseWav"

        config DSP_WAV
            bool "DSPWav"

        config NN_TEST
            bool "NN Test"

    endchoice

    choice QUANT_TYPE
        prompt "Quantization Type"
        default FP16MIXED

        config FP16MIXED
            bool "Mixed FP16-INT8"
            select CNN_SQ8
            select CNN_FP16

        config FP16
            bool "FP16"
            select CNN_FP16

        if DSP_WAV || NN_TEST
        config 8
            bool "int8"
            select CNN_SQ8
        endif

        if DSP_WAV || NN_TEST
        config NE16
            bool "NE16"
            select CNN_SQ8
            select CNN_NE16
        endif

    endchoice

    config CHECKSUM
        bool "Enable Checksum for CI purpose"
        default n

    config GRU
        bool "Use GRU model based (otherwise: LSTM)"
        default y

    config SILENT
        bool "Silence Mode"
        default y

    config VOLTAGE
        int "GAP9 Voltage" 
        default 800
        range 650 800

endmenu
source "$(GAP_SDK_HOME)/utils/kconfig/Kconfig"
```
